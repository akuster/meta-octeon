## conf/layer.conf
```bitbake
# We have a conf and classes directory, add to BBPATH
BBPATH .= ":${LAYERDIR}"

# We have a recipes-* directories, add to BBFILES
BBFILES += "${LAYERDIR}/recipes-*/*/*.bb \
    ${LAYERDIR}/recipes-*/*/*.bbappend"

BBFILE_COLLECTIONS += "octeon"
BBFILE_PATTERN_octeon = "^${LAYERDIR}/"
BBFILE_PRIORITY_octeon = "6"
```

## conf/machine/cavium-cn78xx-64.conf
```bitbake
#@TYPE: Machine
#@NAME: Cavium Octeon3 CN78XX EVB-BASE-BOARD 64bit
#@DESCRIPTION: cavium-cn78xx-64

DEFAULTTUNE = "octeon3_64"
require conf/machine/include/octeon3.inc

IMAGE_FSTYPES += " cpio.gz"
```

## conf/machine/cavium-cn78xx.conf
```bitbake
#@TYPE: Machine
#@NAME: Cavium Octeon3 CN78XX EVB-BASE-BOARD
#@DESCRIPTION: cavium-cn78xx

include conf/machine/include/octeon3.inc

IMAGE_FSTYPES += "cpio.gz"
```

## conf/machine/include/octeon-default-settings.inc
```bitbake
# Octeon BSP default settings

IMAGE_FSTYPES ?= " ext4 tar.gz"

SERIAL_CONSOLE ?= "115200 ttyS0"

MACHINE_EXTRA_RRECOMMENDS ?= " kernel-modules"
```

## conf/machine/include/octeon.inc
```bitbake
# Cavium Octeon Soc 

SOC_FAMILY = "octeon"
include conf/machine/include/soc-family.inc
require conf/machine/include/tune-octeon.inc

IMAGE_FSTYPES ?= " ext4 tar.gz"

SERIAL_CONSOLE ?= "115200 ttyS0"

MACHINE_EXTRA_RRECOMMENDS ?= " kernel-modules"
PREFERRED_VERSION_linux-yocto ?= "3.14%"
PREFERRED_PROVIDER_virtual/kernel ?= "linux-yocto"
```

## conf/machine/include/octeon3.inc
```bitbake
# Cavium Octeon III

DEFAULTTUNE ?= "octeon2"
include conf/machine/include/octeon.inc

KERNEL_IMAGETYPE ?= "vmlinux.64"
KERNEL_OUTPUT ?= "vmlinux.64"
```

## conf/machine/router-ref-cn71xx-64.conf
```bitbake
#@TYPE: Machine
#@NAME: Cavium Router Reference CN7000 evb 64bit
#@DESCRIPTION: router-ref-octeon3-64

DEFAULTTUNE = "octeon2_64"
require conf/machine/include/octeon3.inc

IMAGE_FSTYPES += " cpio.gz" 
```

## conf/machine/router-ref-cn71xx.conf
```bitbake
#@TYPE: Machine
#@NAME: Cavium Router Reference CN7000 evb
#@DESCRIPTION: router-ref-octeon3

DEFAULTTUNE = "octeon3"
require conf/machine/include/octeon3.inc

IMAGE_FSTYPES += "cpio.gz"
```
